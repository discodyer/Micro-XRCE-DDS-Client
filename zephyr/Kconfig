## zephyr/Kconfig
```kconfig
# SPDX-License-Identifier: Apache-2.0

config MICRO_XRCE_DDS_CLIENT
    bool "Micro XRCE-DDS Client"
    default 0
    select MICRO_CDR
    help
      Enable the Micro XRCE-DDS Client library support.
      This library provides DDS-XRCE protocol implementation
      for microcontroller environments.
      This will automatically enable Micro CDR library as a dependency.

if MICRO_XRCE_DDS_CLIENT

config MICRO_XRCE_DDS_CLIENT_CUSTOM_TRANSPORT
    bool "Use custom transport implementation"
    default y
    help
      Enable custom transport implementation instead of built-in
      UDP, TCP or serial transports.

config MICRO_XRCE_DDS_CLIENT_TRANSPORT_MTU
    int "Transport MTU size"
    default 512
    help
      Maximum transmission unit size for the transport layer.

endif # MICRO_XRCE_DDS_CLIENT
```
